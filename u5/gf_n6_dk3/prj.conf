## CMakeLists.txt
```
# SPDX-License-Identifier: Apache-2.0

cmake_minimum_required(VERSION 3.20.0)

find_package(Zephyr REQUIRED HINTS $ENV{ZEPHYR_BASE})
project(gf_n6_dk3)

target_include_directories(app PRIVATE
src
)

target_sources(app PRIVATE
src/application.cpp
src/main.c)
```

## prj.conf
```kconfig
# nothing here
CONFIG_LOG_DEFAULT_LEVEL=3

#CONFIG_FAULT_DUMP=2
CONFIG_ASSERT=y
#CONFIG_RESET_ON_FATAL_ERROR=n
#CONFIG_LOG=y

CONFIG_HW_STACK_PROTECTION=y   # if supported
CONFIG_STACK_SENTINEL=y
CONFIG_INIT_STACKS=y

CONFIG_MAIN_STACK_SIZE=65536

CONFIG_CPP=y
CONFIG_STD_CPP20=y
CONFIG_CPP_EXCEPTIONS=y
CONFIG_CPP_RTTI=y

CONFIG_REQUIRES_FULL_LIBC=y
CONFIG_GLIBCXX_LIBCPP=y

CONFIG_NEWLIB_LIBC=y
CONFIG_PICOLIBC=n

CONFIG_COMMON_LIBC_MALLOC=y
CONFIG_HEAP_MEM_POOL_SIZE=8192

CONFIG_POSIX_API=y

CONFIG_ASSERT_VERBOSE=y

CONFIG_FPU=y

CONFIG_FAULT_DUMP=2

CONFIG_DMA_LOG_LEVEL_DBG=y

# Video / DCMI logs
CONFIG_VIDEO_LOG_LEVEL_DBG=y
CONFIG_VIDEO_LOG_LEVEL_INF=y

CONFIG_STM32_JPEG_RGB_FORMAT=3
CONFIG_GRINREFLEX_JPEG_VIDEO=n
CONFIG_GRINREFLEX_JPEG_VIDEO_QUALITY=10
CONFIG_GRINREFLEX_VIDEO_WIDTH=320
CONFIG_GRINREFLEX_VIDEO_HEIGHT=240

CONFIG_VIDEO_STM32_DCMIPP_SENSOR_WIDTH=320
CONFIG_VIDEO_STM32_DCMIPP_SENSOR_HEIGHT=240
CONFIG_VIDEO_STM32_DCMIPP_SENSOR_PIXEL_FORMAT="RGBP"

CONFIG_DCACHE=y
```

## src/main.c
```c
/*
 * Copyright (c) 2012-2014 Wind River Systems, Inc.
 *
 * SPDX-License-Identifier: Apache-2.0
 */

#include <zephyr/kernel.h>
#include <stdio.h>

#include "application.h"

int main(void)
{
	printf("Hello World! %s\n", CONFIG_BOARD_TARGET);
	init();

	while (true) {
		loop();
	}
	return 0;
}
```

## src/application.cpp
```c
#include <iostream>
#include <lvgl.h>
#include <lvgl_input_device.h>
#include <stdio.h>
#include <string.h>
#include <vector>
#include <zephyr/device.h>
#include <zephyr/devicetree.h>
#include <zephyr/drivers/display.h>
#include <zephyr/drivers/gpio.h>
#include <zephyr/kernel.h>

#include <stdio.h>

#define LOG_LEVEL CONFIG_LOG_DEFAULT_LEVEL
#include <zephyr/logging/log.h>
LOG_MODULE_REGISTER(grinreflex_app);

#include <app/drivers/jpeg.h>

#include "application.h"
#include "config.hpp"
#include "gf/lvgl_utils.hpp"
#include "gf/utils.hpp"
#include "gf/video.hpp"

static const struct device *video_dev = DEVICE_DT_GET(DT_CHOSEN(zephyr_camera));
static const struct device *display_dev =
    DEVICE_DT_GET(DT_CHOSEN(zephyr_display));

#if defined(CONFIG_STM32_JPEG)
const struct device *jpeg_dev = DEVICE_DT_GET(DT_CHOSEN(zephyr_jpeg));
#endif

static uint8_t
    fullFrameBuffer[FULL_FRAME_WIDTH * FULL_FRAME_HEIGHT *
                    LV_COLOR_FORMAT_GET_SIZE(FULL_FRAME_COLOR_FORMAT)];
static uint8_t roiFrameBuffer[ROI_FRAME_WIDTH * ROI_FRAME_HEIGHT *
                              LV_COLOR_FORMAT_GET_SIZE(LV_COLOR_FORMAT_L8)];
static uint8_t
    thumbnailFrameBuffer[THUMBNAIL_FRAME_WIDTH * THUMBNAIL_FRAME_HEIGHT *
                         LV_COLOR_FORMAT_GET_SIZE(LV_COLOR_FORMAT_L8)];

static lv_obj_t *screen_canvas;
static lv_obj_t *dummy_canvas;

int init() {
  if (!device_is_ready(display_dev)) {
    LOG_ERR("Display device not ready, aborting test");
    return -ENODEV;
  }

  if (!device_is_ready(video_dev)) {
    LOG_ERR("Video device not ready, aborting test");
    return -ENODEV;
  }
#if defined(CONFIG_STM32_JPEG)
  if (!device_is_ready(jpeg_dev)) {
    printf("%s JPEG device not ready", jpeg_dev->name);
    return -ENODEV;
  }
#endif
  Video::setup();

  dummy_canvas = lv_canvas_create(NULL);
  screen_canvas = lv_canvas_create(lv_screen_active());
  lv_canvas_fill_bg(screen_canvas, lv_color_hex3(0xccc), LV_OPA_COVER);
  lv_obj_center(screen_canvas);

  display_blanking_off(display_dev);
  lv_task_handler();

  return 0;
}

int loop() {

  struct video_buffer vbuf {};
  struct video_buffer *vbuf_ptr = &vbuf;

  vbuf_ptr->type = VIDEO_BUF_TYPE_OUTPUT;

  int err = video_dequeue(video_dev, &vbuf_ptr, K_FOREVER);
  if (err) {
    LOG_ERR("Unable to dequeue video buf");
    return 0;
  }

  memcpy(fullFrameBuffer, vbuf_ptr->buffer, vbuf_ptr->bytesused);

  err = video_enqueue(video_dev, vbuf_ptr);
  if (err) {
    LOG_ERR("Unable to requeue video buf");
  }

  cropFullFrameToRoi(dummy_canvas, fullFrameBuffer, roiFrameBuffer,
                     lvgl::Size(FULL_FRAME_WIDTH, FULL_FRAME_HEIGHT),
                     lvgl::Size(ROI_FRAME_WIDTH, ROI_FRAME_HEIGHT),
                     FULL_FRAME_COLOR_FORMAT, LV_COLOR_FORMAT_L8,
                     FULL_FRAME_FLIP_Y);

  fitRoiFrameToThumbnail(
      screen_canvas, roiFrameBuffer, thumbnailFrameBuffer,
      lvgl::Size(ROI_FRAME_WIDTH, ROI_FRAME_HEIGHT),
      lvgl::Size(THUMBNAIL_FRAME_WIDTH, THUMBNAIL_FRAME_HEIGHT),
      LV_COLOR_FORMAT_L8, LV_COLOR_FORMAT_L8);
  lv_task_handler();

  k_msleep(50);

  return 0;
}
```

## src/application.h
```c
#ifndef GRINREFLEX_APPLICATION_H
#define GRINREFLEX_APPLICATION_H

#ifdef __cplusplus
extern "C" {
#endif

int init();

int loop();

#ifdef __cplusplus
}
#endif

#endif /* GRINREFLEX_APPLICATION_H */
```

## src/config.hpp
```c
#pragma once

#if defined(CONFIG_GRINREFLEX_JPEG_VIDEO)

#if defined(CONFIG_STM32_JPEG_RGB_FORMAT)
#if CONFIG_STM32_JPEG_RGB_FORMAT == 0
#define FULL_FRAME_COLOR_FORMAT LV_COLOR_FORMAT_ARGB8888
#elif CONFIG_STM32_JPEG_RGB_FORMAT == 1
#define FULL_FRAME_COLOR_FORMAT LV_COLOR_FORMAT_RGB888
#elif CONFIG_STM32_JPEG_RGB_FORMAT == 2
#define FULL_FRAME_COLOR_FORMAT LV_COLOR_FORMAT_RGB565
#elif CONFIG_STM32_JPEG_RGB_FORMAT == 3
#define FULL_FRAME_COLOR_FORMAT LV_COLOR_FORMAT_L8
#else
#error "CONFIG_STM32_JPEG_RGB_FORMAT is not supported"
#endif

#else
#define FULL_FRAME_COLOR_FORMAT LV_COLOR_FORMAT_RGB888
#endif /* !defined(CONFIG_STM32_JPEG_RGB_FORMAT) */

#else
#define FULL_FRAME_COLOR_FORMAT LV_COLOR_FORMAT_RGB565
#endif /* !defined(CONFIG_GRINREFLEX_JPEG_VIDEO) */

#define FULL_FRAME_WIDTH CONFIG_GRINREFLEX_VIDEO_WIDTH
#define FULL_FRAME_HEIGHT CONFIG_GRINREFLEX_VIDEO_HEIGHT

#define ROI_FRAME_WIDTH 320
#define ROI_FRAME_HEIGHT 240

#define THUMBNAIL_FRAME_WIDTH 90
#define THUMBNAIL_FRAME_HEIGHT 90

#define INPUT_PREPROCESS_OPENCV (0)
#define FULL_FRAME_FLIP_Y (0)
```
