## u5/Models/yolov8_obj_det/Kconfig
```kconfig
config YOLOV8_OBJ_DET
    bool "Add yolov8 object detection model"
    default n
```

## u5/boards/vendor/grinreflex/Kconfig.grinreflex_dk1
```kconfig
# Copyright (c) 2025 Grinreflex

config BOARD_GRINREFLEX_DK1
	select SOC_STM32U5G9XX
```

## u5/boards/vendor/grinreflex/board.yml
```yaml
board:
  name: grinreflex_dk1
  full_name: Grinreflex Development kit v1.0
  vendor: grinreflex
  socs:
    - name: stm32u5g9xx
```

## u5/boards/vendor/grinreflex_dk2/Kconfig.grinreflex_dk2
```kconfig
# Copyright (c) 2025 Grinreflex

config BOARD_GRINREFLEX_DK2
	select SOC_STM32U5G9XX

menu "GrinReflex Video settings"

config GRINREFLEX_JPEG_VIDEO
	bool "Enable jpeg video input"
	default y

config GRINREFLEX_JPEG_VIDEO_QUALITY
    int "Set jpeg quality, lower value - higher quality"
    default 63
    depends on GRINREFLEX_JPEG_VIDEO

config GRINREFLEX_VIDEO_WIDTH
    int "Width of a video frame"
    default 160

config GRINREFLEX_VIDEO_HEIGHT
    int "Height of a video frame"
    default 120

config GRINREFLEX_VIDEO_RGB565_SWAP_BYTES
	bool "Swap rgb565 bytes (e.g. in ov2640 sensor)"
	default n

endmenu

menu "GrinReflex LVGL settings"

if GRINREFLEX_JPEG_VIDEO
config LV_COLOR_16_SWAP
    bool
    default y
endif

endmenu
```

## u5/boards/vendor/grinreflex_dk2/board.yml
```yaml
board:
  name: grinreflex_dk2
  full_name: Grinreflex Development kit v2.0
  vendor: grinreflex
  socs:
    - name: stm32u5g9xx
```

## u5/boards/vendor/grinreflex_dk2/grinreflex_dk2_defconfig
```kconfig
# Copyright (c) 2025 STMicroelectronics
# SPDX-License-Identifier: Apache-2.0

# Enable MPU
CONFIG_ARM_MPU=y

# Enable HW stack protection
CONFIG_HW_STACK_PROTECTION=y

# Enable serial
CONFIG_SERIAL=y

# Enable console
CONFIG_CONSOLE=y
CONFIG_UART_CONSOLE=y

# Enable GPIO
CONFIG_GPIO=y

CONFIG_VIDEO=y
CONFIG_VIDEO_LOG_LEVEL_DBG=y

CONFIG_VIDEO_LOG_LEVEL_INF=y

CONFIG_STM32_JPEG_RGB_FORMAT=3
CONFIG_GRINREFLEX_JPEG_VIDEO=y
CONFIG_GRINREFLEX_JPEG_VIDEO_QUALITY=10
CONFIG_GRINREFLEX_VIDEO_WIDTH=640
CONFIG_GRINREFLEX_VIDEO_HEIGHT=480

#CONFIG_VIDEO_BUFFER_POOL_SZ_MAX=76800
CONFIG_VIDEO_BUFFER_POOL_SZ_MAX=153600

#CONFIG_LV_COLOR_16_SWAP=y
```

## u5/boards/vendor/grinreflex_n6_dk3/Kconfig.grinreflex_n6_dk3
```kconfig
# STM32N657X0_Q Nucleo board configuration

# Copyright (c) 2024 STMicroelectronics
# SPDX-License-Identifier: Apache-2.0

config BOARD_GRINREFLEX_N6_DK3
	select SOC_STM32N657XX

menu "GrinReflex Video settings"

config GRINREFLEX_VIDEO_RGB565_SWAP_BYTES
	bool "Swap rgb565 bytes (e.g. in ov2640 sensor)"
	default n

endmenu

menu "GrinReflex LVGL settings"

if GRINREFLEX_JPEG_VIDEO
config LV_COLOR_16_SWAP
    bool
    default y
endif

endmenu
```

## u5/boards/vendor/grinreflex_n6_dk3/board.yml
```yaml
board:
  name: grinreflex_n6_dk3
  full_name: Grinreflex N6 DK3 from Nucleo N657X0-Q
  vendor: grinreflex
  socs:
    - name: stm32n657xx
      variants:
        - name: fsbl
```

## u5/boards/vendor/grinreflex_n6_dk3/grinreflex_n6_dk3_defconfig
```kconfig
# SPDX-License-Identifier: Apache-2.0
# Copyright (c) 2024 STMicroelectronics

# Enable UART driver
CONFIG_SERIAL=y

# Enable GPIO
CONFIG_GPIO=y

# Console
CONFIG_CONSOLE=y
CONFIG_UART_CONSOLE=y
CONFIG_EARLY_CONSOLE=y

# Enable HW stack protection
CONFIG_HW_STACK_PROTECTION=y

CONFIG_ARM_MPU=n
#CONFIG_XIP=y

#CONFIG_VIDEO=y
#CONFIG_VIDEO_LOG_LEVEL_DBG=y
#CONFIG_VIDEO_LOG_LEVEL_INF=y

#CONFIG_STM32_JPEG_RGB_FORMAT=3
#CONFIG_GRINREFLEX_JPEG_VIDEO=y
#CONFIG_GRINREFLEX_JPEG_VIDEO_QUALITY=10
#CONFIG_GRINREFLEX_VIDEO_WIDTH=640
#CONFIG_GRINREFLEX_VIDEO_HEIGHT=480

#CONFIG_VIDEO_BUFFER_POOL_SZ_MAX=76800
#CONFIG_VIDEO_BUFFER_POOL_SZ_MAX=153600

#CONFIG_DISPLAY=y
#CONFIG_DISPLAY_LOG_LEVEL_ERR=y
```

## u5/boards/vendor/grinreflex_n6_dk3/grinreflex_n6_dk3_stm32n657xx_app_defconfig
```kconfig
# SPDX-License-Identifier: Apache-2.0
# Copyright (c) 2024 STMicroelectronics

# Enable UART driver
CONFIG_SERIAL=y

# Enable GPIO
CONFIG_GPIO=y

# Console
CONFIG_CONSOLE=y
CONFIG_UART_CONSOLE=y
CONFIG_EARLY_CONSOLE=y

# Enable HW stack protection
CONFIG_HW_STACK_PROTECTION=y

CONFIG_ARM_MPU=n
#CONFIG_XIP=y

CONFIG_LOG=y
CONFIG_LOG_DEFAULT_LEVEL=4

CONFIG_VIDEO=y
CONFIG_VIDEO_LOG_LEVEL_INF=y

CONFIG_SHELL=y

CONFIG_VIDEO=y
CONFIG_VIDEO_LOG_LEVEL_DBG=y
CONFIG_VIDEO_LOG_LEVEL_INF=y

#CONFIG_STM32_JPEG_RGB_FORMAT=3
#CONFIG_GRINREFLEX_JPEG_VIDEO=y
#CONFIG_GRINREFLEX_JPEG_VIDEO_QUALITY=10
#CONFIG_GRINREFLEX_VIDEO_WIDTH=640
#CONFIG_GRINREFLEX_VIDEO_HEIGHT=480

#CONFIG_VIDEO_BUFFER_POOL_SZ_MAX=76800
CONFIG_VIDEO_BUFFER_POOL_SZ_MAX=153600

CONFIG_DISPLAY=y
CONFIG_DISPLAY_LOG_LEVEL_ERR=y
CONFIG_DISPLAY_LOG_LEVEL_DBG=y

CONFIG_SPI_LOG_LEVEL_DBG=y
CONFIG_CLOCK_CONTROL_LOG_LEVEL_DBG=y
CONFIG_PINCTRL_LOG_LEVEL_DBG=y

#CONFIG_LV_Z_MEM_POOL_SIZE=16384
#CONFIG_LV_Z_SHELL=n
#CONFIG_LVGL=y
#CONFIG_LV_USE_LOG=n
#CONFIG_LV_USE_LABEL=n
#CONFIG_LV_USE_ARC=y
#CONFIG_LV_USE_IMAGE=y
#CONFIG_LV_FONT_MONTSERRAT_14=y

#CONFIG_LV_CACHE_DEF_SIZE=4096
#CONFIG_LV_IMAGE_HEADER_CACHE_DEF_CNT=1
#CONFIG_LV_USE_BUILTIN_MALLOC=n

#CONFIG_LV_USE_PERF_MONITOR=y
#CONFIG_LV_USE_DROPDOWN=y
#CONFIG_LV_USE_SYSMON=y

#CONFIG_SPI=y
#CONFIG_SPI_SHELL=y

CONFIG_SPI_STM32=y
CONFIG_SPI_STM32_USE_HW_SS=n
CONFIG_DISPLAY_INIT_PRIORITY=100
```

## u5/boards/vendor/grinreflex_n6_dk3/grinreflex_n6_dk3_stm32n657xx_fsbl_app_defconfig
```kconfig
# SPDX-License-Identifier: Apache-2.0
# Copyright (c) 2024 STMicroelectronics

# Enable UART driver
CONFIG_SERIAL=y

# Enable GPIO
CONFIG_GPIO=y

# Console
CONFIG_CONSOLE=y
CONFIG_UART_CONSOLE=y
#CONFIG_EARLY_CONSOLE=y

# Enable MPU
CONFIG_ARM_MPU=y

# Enable HW stack protection
CONFIG_HW_STACK_PROTECTION=y

# No internal Flash
CONFIG_XIP=n

CONFIG_LOG=y
CONFIG_LOG_DEFAULT_LEVEL=4

CONFIG_VIDEO=y
CONFIG_VIDEO_LOG_LEVEL_INF=y

CONFIG_SHELL=y
#CONFIG_VIDEO_SHELL=y
```

## u5/drivers/Kconfig
```kconfig
# Copyright (c) 2021 Nordic Semiconductor ASA
# SPDX-License-Identifier: Apache-2.0

menu "Drivers"
rsource "nema/Kconfig"
rsource "jpeg/Kconfig"
endmenu
```

## u5/drivers/jpeg/Kconfig
```kconfig
# Copyright (c) 2025 Grinreflex

menu "STM32 JPEG hw decoder"

config STM32_JPEG
	bool "STM32 JPEG HW decoder device drivers"
    default n

    select USE_STM32_HAL_DMA
    select USE_STM32_HAL_JPEG
    select USE_STM32_HAL_CORTEX
    select USE_STM32_HAL_DMA_EX

	help
	  This option enables STM32 JPEG HW decoder.

config STM32_JPEG_LOG_LEVEL
  int "STM32_JPEG_LOG_LEVEL"
    default 3

config STM32_JPEG_RGB_FORMAT
  int "STM32_JPEG_RGB_FORMAT"
    default 1

  help
    0: JPEG_ARGB8888
    1: JPEG_RGB888
    2: JPEG_RGB565
    3: JPEG_GRAY

config STM32_JPEG_USE_DECODER
  bool "STM32_JPEG_USE_DECODER"
    default y

config STM32_JPEG_USE_ENCODER
  bool "STM32_JPEG_USE_ENCODER"
    default n

endmenu

if STM32_JPEG

config STM32_JPEG_INIT_PRIORITY
	int "STM32 JPEG HW decoder device drivers init priority"
	default KERNEL_INIT_PRIORITY_DEVICE
	help
	  STM32 JPEG HW decoder drivers init priority.

module = STM32_JPEG
module-str = stm32-jpeg

endif # STM32_JPEG
```

## u5/drivers/nema/Kconfig
```kconfig
# Copyright (c) 2025 Grinreflex

menu "Nema Gfx"

config NEMA
	bool "NEMA gfx device drivers"
    default n

    depends on FPU
    depends on FP_SOFTABI

	help
	  This option enables NEMA gfx Driver (stm32 gpu2d).

config NEMA_LOG_LEVEL
    int "NEMA_LOG_LEVEL"
    default 3

config LV_USE_NEMA_GFX
    bool "Use LV_NEMA_GFX on the supporting STM32 platforms"
    default y
    depends on NEMA
    select USE_STM32_HAL_GPU2D
    select USE_STM32_HAL_CORTEX
    help
        LV_USE_NEMA_GFX.

config LV_USE_NEMA_HAL
    int "Use LV_NEMA_HAL on the supporting STM32 platforms"
    depends on NEMA
    default 1
    help
        LV_USE_NEMA_HAL.

endmenu

if NEMA

config NEMA_INIT_PRIORITY
	int "NEMA device drivers init priority"
	default KERNEL_INIT_PRIORITY_DEVICE
	help
	  NEMA device drivers init priority.

module = NEMA
module-str = nema

endif # NEMA
```

## u5/dts/bindings/jpeg/st,jpeg-hw.yaml
```yaml
description: |
  stm32 jpeg hw decoder

compatible: "st,jpeg-hw"

include: base.yaml

properties: {}
```

## u5/dts/bindings/nema/st,nema-gfx.yaml
```yaml
description: |
  st GPU2D, nema gfx driver

compatible: "st,nema-gfx"

include: base.yaml

properties: {}
```

## u5/lib/Kconfig
```kconfig
# Copyright (c) 2021 Legrand North America, LLC.
# SPDX-License-Identifier: Apache-2.0

menu "Custom libraries"

rsource "cv/Kconfig"
rsource "tflite/Kconfig"
rsource "quirc/Kconfig"
rsource "st_ai_runtime/Kconfig"

endmenu
```

## u5/lib/cv/Kconfig
```kconfig
config OPENCV_LIB
	bool "Support for opencv custom library"

config OPENCV_FORCE_3RDPARTY_BUILD
	bool "Build opencv 3d party libraries"
	default n
	depends on OPENCV_LIB
```

## u5/lib/st_ai_runtime/Kconfig
```kconfig
config STM32_NPU
	bool "Enable app"
	default n
	select USE_STM32_HAL_RAMCFG
	select USE_STM32_HAL_CACHEAXI
	select FPU
	select CMSIS_DSP
	help
		enable application

config NPU_WIDTH
	int "Width of neural network input image"
	default 224
	help
		Width of neural network input image

config NPU_HEIGHT
	int "Height of neural network input image"
	default 224
	help
		Height of neural network input image
```

## u5/lib/tflite/Kconfig
```kconfig
config TFLITE_LIB
	bool "Support for tflite custom library"
    imply TENSORFLOW_LITE_MICRO
    # imply CONFIG_TENSORFLOW_LITE_MICRO_CMSIS_NN_KERNELS
	help
	  This option enables the 'tflite custom' library
```

## u5/west.yml
```yaml
# Copyright (c) 2021 Nordic Semiconductor ASA
# SPDX-License-Identifier: Apache-2.0

manifest:
  self:
    west-commands: scripts/west-commands.yml

  defaults:
    remote: upstream

  remotes:
    - name: upstream
      url-base: https://github.com/zephyrproject-rtos/
    - name: origin
      url-base: https://github.com/cornway/

  projects:
    - name: zephyr
      remote: origin
      revision: roman/development-n6
      import:
        # By using name-allowlist we can clone only the modules that are
        # strictly needed by the application.
        name-allowlist:
          - cmsis_6    # required by the ARM port for Cortex-M
          - cmsis-dsp
          - hal_stm32
          - tflite-micro
          - lvgl
          - mbedtls
    - name: mcuboot
      remote: origin
      revision: roman/development
      path: bootloader/mcuboot
```
